## components/sq_coap/Kconfig.projbuild
```kconfig
menu "Squidward CoAP Configuration"

	config SQ_COAP_URI
		string "Server URI to connect to"
		default "coaps://192.168.12.1"
		help
			Set the server name or IP to send/receive CoAP messages to/from.

	config SQ_COAP_LOG_LEVEL
		int "CoAP log level"
		default 4
		help
			Set the log level of CoAP, from 0-7.
	
	config SQ_COAP_TIME_SEC
		int "CoAP timeout value in seconds"
		default 5
		help
			Set the number of seconds before a CoAP timeout is triggered.

	config SQ_COAP_PSK_KEY
		string "CoAP Pre-shared Key"
		default "password"
		help
			Set the shared (PSK) key when authenticate via (D)TLS.
	
	config SQ_COAP_PSK_IDENTITY
		string "CoAP PSK Identity"
		default "squidward"
		help
			Set the identity of the device when using PSK for authentication.

endmenu
```

## components/sq_uart/Kconfig.projbuild
```kconfig
menu "Squidward UART Configuration"

	config SQ_UART_DBG
		boolean "Print debug logs"
		default y
		help
			Turn on or off debug logs from the uart functions.

	config SQ_UART_CTRL_PIN
		int "UART Control Pin"
		default 4
		help
			Set the output IO pin for switching the UART output to the Otii.

	config SQ_UART_BAUDRATE
		int "UART Baudrate"
		default 115200
		help
			Set the baudrate of the UART device. Use values 
			like 9600, 19200, 38400, 115200.

endmenu
```

## components/sq_wifi/Kconfig.projbuild
```kconfig
menu "Squidward WiFi Configuration"

	config SQ_WIFI_SSID
		string "WiFi SSID"
		default "test"
		help
			WiFi SSID to connect to.
	
	config SQ_WIFI_PASSWORD
		string "WiFi Password"
		default ""
		help
			WiFi password to use.
	
endmenu
```

## esp-idf/examples/protocols/coap_client/main/Kconfig.projbuild
```kconfig
menu "Example Configuration"

    config TARGET_DOMAIN_URI
        string "Target Uri"
        default "coap://californium.eclipse.org"
        help
            Target uri for the example to use. Use coaps:// prefix for encrypted traffic using the PSK.

    config COAP_PSK_KEY
        string "Preshared Key (PSK) to used in the connection to the CoAP server"
        default "secret-key"
        help
            The Preshared Key to use to encrypt the communicatons. The same key must be 
            used at both ends of the CoAP connection, and the CoaP client must request 
            an URI prefixed with coaps:// instead of coap:// for DTLS to be used.

    config COAP_PSK_IDENTITY
        string "PSK Client identity (username)"
        default "coap-client"
        help
            The identity (or username) to use to identify to the CoAP server which
            PSK key to use.

endmenu
```

## esp32-examples/fota_coap/main/Kconfig.projbuild
```kconfig
menu "Example Configuration"

config WIFI_SSID
    string "WiFi SSID"
	default "test"
	help
		SSID (network name) for the example to connect to.

config WIFI_PASSWORD
    string "WiFi Password"
	default ""
	help
		WiFi password (WPA or WPA2) for the example to use.

		Can be left blank if the network has no security set.

config FIRMWARE_UPG_URL
    string "HTTP Server URL"
    default "https://192.168.0.3:8070/hello-world.bin"
	help
		HTTP Server IP to download the image file from.

		See example README.md for details.

endmenu
```

## src/coaps/main/Kconfig.projbuild
```kconfig
menu "Squidward CoAPs Main Configuration"

	config SQ_MAIN_DBG
		boolean "Print debug logs"
		default n
		help
			Turn on or off logs from the main code.

endmenu
```

## src/coaps_fota/main/Kconfig.projbuild
```kconfig
menu "Squidward CoAPs FOTA Configuration"

	config SQ_MAIN
		boolean "Print debug logs"
		default n
		help
			Turn on or off logs from the main code.

endmenu
```

## src/mqtts/main/Kconfig.projbuild
```kconfig
menu "Squidward MQTTs Main Configuration"

    config SQ_MAIN_DBG
		boolean "Print debug logs"
		default n
		help
			Turn on or off logs from the main code

	config BROKER_URI
        string "Broker URL"
        default "mqtts://iot.eclipse.org:8883"
        help
            URL of an mqtt broker which this example connects to.

    choice SQ_MQTT_CERT_MODE
		prompt "MQTT certificate type"
		default SQ_MQTT_CERT_RSA
		help
			Select which certificate type to be used (default RSA)

		config SQ_MQTT_CERT_RSA
			bool "RSA keys"

		config SQ_MQTT_CERT_ECDSA
			bool "ECDSA keys"

	endchoice

endmenu
```

## src/mqtts_handshake/main/Kconfig.projbuild
```kconfig
menu "Squidward MQTTs Main Configuration"

    config SQ_MAIN_DBG
		boolean "Print debug logs"
		default n
		help
			Turn on or off logs from the main code

	config BROKER_URI
        string "Broker URL"
        default "mqtts://iot.eclipse.org:8883"
        help
            URL of an mqtt broker which this example connects to.
		
	choice SQ_MQTT_ENC_MODE
		prompt "MQTT encryption method"
		default SQ_MQTT_PSK
		help
			Select which encryption method to be used if setting up
			a secure connection

			- Encrypt using Pre-Shared Keys (PSK if mqtts://)
			- Encrypt using Public Key Infrastructure (PKI if mqtts://)

		config SQ_MQTT_PSK
			bool "Pre-Shared Keys"

		config SQ_MQTT_PKI
			bool "PKI certificates"

	endchoice

	choice SQ_MQTT_CERT_MODE
		prompt "MQTT certificate type"
		default SQ_MQTT_CERT_RSA
		help
			Select which certificate type to be used (default RSA)

		config SQ_MQTT_CERT_RSA
			bool "RSA keys"

		config SQ_MQTT_CERT_ECDSA
			bool "ECDSA keys"
	
	endchoice

endmenu
```
